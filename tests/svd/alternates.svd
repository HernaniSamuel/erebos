# ALTERNATES register map
Registers are 32-bit, read-write, no defined reset value unless marked. A register's access mark holds for its fields unless they carry their own. Offsets are from the block's base; lines under a group give offsets from that group; [hi:lo] are bit positions; {n}, {i} and the like mark numbered series; 'fields as' and 'values as' point back to an identical list; <NAME> marks a mode.

## Memory map
0x10000000 UART
0x40000000 TIMER

## TIMER
Base 0x40000000
0x18 CH0CTL0_Output (alternate view of CH0CTL0_Input) — The channel control register in output compare mode.
0x18 CH0CTL0_Input — The same register in input capture mode.
0x20 BOTH (alternate view of OTHER) — States both: the group wins.
0x20 NEUTRAL
0x24 CONT (CONTINUE view) — A group named like a keyword.
0x24 CONT_PLAIN

## UART
Base 0x10000000
0x00 RBR 8-bit ro read-modifies — Read at offset 0: no group, since a read and a write register may share it.
0x00 THR 8-bit wo
0x00 DLL 8-bit (DLAB view)
0x01 DLM 8-bit (DLAB view)
0x01 IER 8-bit (DLAB_OFF view)
