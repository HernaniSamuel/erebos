# PERIPHERALS register map
Registers are 32-bit, read-write, no defined reset value unless marked. A register's access mark holds for its fields unless they carry their own. Offsets are from the block's base; lines under a group give offsets from that group; [hi:lo] are bit positions; {n}, {i} and the like mark numbered series; 'fields as' and 'values as' point back to an identical list; <NAME> marks a mode.

## Memory map
0x60000000 UART0 — The first UART.
0x60001000 UART1 — Derived with no register of its own: shares UART0's type.
0x60002000 UART2 — Derived with a reset value of its own: a type of its own.
0x60003000 UART3 — Derived with a register of its own, added after the base's.
0x60004000 UART4 — Derived from a peripheral that shares: shares the type too.
0x60026000 APB_CTRL
0x60026000 RNG — Lies inside APB_CTRL, and the SVD does not say so.
{0x61000000+0x1000*n} TIMG{n} (n=0..1) — Two timer groups, one type.
0x61000000 TIMG_VIEW — Stated over a list: over its first peripheral.
0x70000000 A
0x70000000 B
0x70000000 C — Shares bytes with A and with B: over A, to which B is over.
0x71000000 X
0x72000000 Y — Stated over X, which it does not overlap.
0x72000000 W — Covers Y and Z, which are both over X: over X, which it does not overlap.
0x72001000 Z
0x73000000 P
0x74000000 Q
0x74000000 S — Covers only Q, which is over P: over P, the first candidate in the file.

## UART0 — The first UART.
Base 0x60000000
Same registers: UART1 0x60001000, UART4 0x60004000
0x00 CONF
0x04 STATUS ro

## UART2 — Derived with a reset value of its own: a type of its own.
Base 0x60002000
0x00 CONF reset 0x1
0x04 STATUS ro reset 0x1

## UART3 — Derived with a register of its own, added after the base's.
Base 0x60003000
0x00 CONF
0x04 STATUS ro
0x08 EXTRA

## TIMG{n} — Two timer groups, one type.
Base 0x61000000; array of 2, step 0x1000
0x00 CFG

## APB_CTRL
Base 0x60026000
0xB0 RND_DATA

## RNG — Lies inside APB_CTRL, and the SVD does not say so.
Base 0x60026000
0xB0 DATA ro

## A
Base 0x70000000
{0x0+4i} R{i} (i=0..3)

## B
Base 0x70000000
Same registers: C 0x70000000, X 0x71000000, P 0x73000000, S 0x74000000
0x00 R0

## Y — Stated over X, which it does not overlap.
Base 0x72000000; alternate view of X
Registers as B.

## Z
Base 0x72001000; alternate view of X
Registers as B.

## W — Covers Y and Z, which are both over X: over X, which it does not overlap.
Base 0x72000000
0x00 R0
0x1000 R1

## Q
Base 0x74000000; alternate view of P
Registers as B.

## TIMG_VIEW — Stated over a list: over its first peripheral.
Base 0x61000000; alternate view of TIMG%s
Registers as TIMG{n}.
