# MANY register map
Registers are 32-bit, read-write, no defined reset value unless marked. A register's access mark holds for its fields unless they carry their own. Offsets are from the block's base; lines under a group give offsets from that group; [hi:lo] are bit positions; {n}, {i} and the like mark numbered series; 'fields as' and 'values as' point back to an identical list; <NAME> marks a mode.

## Memory map
{0x40000000+8n} A{n} (n=0..9)
0x40000000 COVER

## A0
Base 0x40000000
Same registers: A{n} {0x40000000+8n} (n=1..9)
0x00 R0

## COVER
Base 0x40000000
0x00 R0
0x4C R1
