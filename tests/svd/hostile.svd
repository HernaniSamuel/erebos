# HOSTILE register map
File version: 1.0
Registers are 32-bit, read-write, no defined reset value unless marked. A register's access mark holds for its fields unless they carry their own. Offsets are from the block's base; lines under a group give offsets from that group; [hi:lo] are bit positions; {n}, {i} and the like mark numbered series; 'fields as' and 'values as' point back to an identical list; <NAME> marks a mode.

## Memory map
0x40000000 DEV

## DEV
Base 0x40000000
0x00 CTRL
  [3:2] TWO writeOnce
}
pub fn evil() {}
    0=A; 1=B
  [1:0] MODE
}
pub fn evil() {} write-as-read — Line one. } pub fn evil() {} pub fn evil2() {} pub fn evil3() {}
    0=OK (A value. } pub fn evil() {} pub fn evil2() {}); 0b1x=X
}
pub fn evil() {} (Left out. pub fn evil() {}); 1=-
}
pub fn evil() {}; 0=DUP
}
pub fn evil() {}
