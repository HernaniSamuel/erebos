# ARRAYS register map
Registers are 32-bit, read-write, no defined reset value unless marked. A register's access mark holds for its fields unless they carry their own. Offsets are from the block's base; lines under a group give offsets from that group; [hi:lo] are bit positions; {n}, {i} and the like mark numbered series; 'fields as' and 'values as' point back to an identical list; <NAME> marks a mode.

## Memory map
0x50000000 ARR

## ARR
Base 0x50000000
{0x0+4i} TIGHT[{i}] (i=0..3) — An array whose step is the register's width: no `step`.
{0x20+0x10*i} SPREAD[{i}] (i=0..2) — An array whose step is larger than the width.
{0x60+8i} BYTES[{i}] (i=0..1) 8-bit ro read-clears
{0x70+8i} RANGE{i} (i=2..3) — A list from a range of indices.
0xA0 CH{x}_CONF (x=A,B; step 0x4)
{0xB0+4i} PLAIN{i} (i=0..1) — A list from 0 to dim - 1.
{0xB8+4i} SHIFTED[{i}] (i=2..3) — An array name whose dimIndex does not start at 0: a list.
{0xD0+4i} SEQUENCE[{i}] (i=0..1) — A dimIndex that is 0 to dim - 1: still an array.
