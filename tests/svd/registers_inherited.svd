# INHERITED register map
Registers are 16-bit, read-write, no defined reset value unless marked. A register's access mark holds for its fields unless they carry their own. Offsets are from the block's base; lines under a group give offsets from that group; [hi:lo] are bit positions; {n}, {i} and the like mark numbered series; 'fields as' and 'values as' point back to an identical list; <NAME> marks a mode.

## Memory map
0x40000000 FROM_DEVICE
0x40001000 FROM_PERIPHERAL
0x40002000 FROM_CLUSTER

## FROM_DEVICE
Base 0x40000000
0x00 A ro
0x04 B 32-bit

## FROM_PERIPHERAL
Base 0x40001000
0x00 A 8-bit wo
0x04 B 32-bit

## FROM_CLUSTER
Base 0x40002000
0x00 C group
  0x00 X 8-bit wo
  0x02 Y wo
  0x04 Z 8-bit
0x10 OUTSIDE ro
