# INTERRUPTS register map
Registers are 32-bit, read-write, no defined reset value unless marked. A register's access mark holds for its fields unless they carry their own. Offsets are from the block's base; lines under a group give offsets from that group; [hi:lo] are bit positions; {n}, {i} and the like mark numbered series; 'fields as' and 'values as' point back to an identical list; <NAME> marks a mode.

## Memory map
0x40000000 UART0 — Out of order in the file, and each with a description.
{0x40001000+0x100*n} TIMER{n} (n=0..1) — A dim: its interrupt is one, and the {n} of its name goes.
0x40002000 SHARED_A — One line, named by three peripherals, in three spellings of one name: one variant, with the first description.
0x40002100 SHARED_B
0x40002200 SHARED_C
0x40003000 ALIAS_A — Three names for the line 12: only the first is a variant, and the others are left out.
0x40003100 ALIAS_B — The same three again, in another order: nothing more is said.
0x40004000 TWICE — One name, two values: both are written, the later with an underscore after it.
0x40005000 CONVERTED — Names ADR 0071 converts: characters, a leading digit, and a name Erebos gives a meaning. Values in the other syntaxes of SVD, and the largest of thumbv7m.
0x40006000 Interrupt — A peripheral named as the enum: the enum, written last, is the one renamed.
0x40007000 BASE
0x40007100 DERIVED_NONE — Derived, with no interrupt of its own: the base's are not repeated.
0x40007200 DERIVED_OWN — Derived, with an interrupt of its own: only that one.
0x40008000 QUIET — No interrupt.

## Interrupts
0 FIRST (CONVERTED)
6 UART0_RX (UART0) — UART 0, receive, and a description long enough that the comment above the variant is wrapped at seventy-nine columns.
7 UART0_TX (UART0) — UART 0, transmit.
10 SHARED (SHARED_A) — A line shared by peripherals.
10 __SHARED__ (SHARED_C)
10 shared (SHARED_B) — Another description, not used.
12 DMA_COMPLETE (ALIAS_A, ALIAS_B)
12 DMA_DONE (ALIAS_A, ALIAS_B)
12 DMA_END (ALIAS_A, ALIAS_B)
20 TIMER%s (TIMER{n})
30 edge (TWICE)
31 EDGE (TWICE)
40 RX.FIFO-FULL (CONVERTED)
41 3V3_OK (CONVERTED)
50 OPTION (CONVERTED)
60 BASE_IRQ (BASE)
61 DERIVED_IRQ (DERIVED_OWN)
495 LAST (CONVERTED)

## UART0 — Out of order in the file, and each with a description.
Base 0x40000000
Same registers: SHARED_A 0x40002000, SHARED_B 0x40002100, SHARED_C 0x40002200, ALIAS_A 0x40003000, ALIAS_B 0x40003100, TWICE 0x40004000, CONVERTED 0x40005000, Interrupt 0x40006000, BASE 0x40007000, DERIVED_NONE 0x40007100, DERIVED_OWN 0x40007200, QUIET 0x40008000
0x00 R

## TIMER{n} — A dim: its interrupt is one, and the {n} of its name goes.
Base 0x40001000; array of 2, step 0x100
Registers as UART0.
