# HEADER mod evil; // not source register map
File version: 2.5 beta; mod worse;
Registers are 32-bit, read-write, no defined reset value unless marked. A register's access mark holds for its fields unless they carry their own. Offsets are from the block's base; lines under a group give offsets from that group; [hi:lo] are bit positions; {n}, {i} and the like mark numbered series; 'fields as' and 'values as' point back to an identical list; <NAME> marks a mode.

## Memory map
0x40000000 DEV — A description over several lines, with extra white space that collapses into single spaces.

## DEV — A description over several lines, with extra white space that collapses into single spaces.
Base 0x40000000
0x00 LONG_TEXT — A description long enough to wrap: the quick brown fox jumps over the lazy dog, and then it does so again and again until the line has to break at the 79th column of the generated text.
0x04 LONG_WORD — Before xxxxxxxxxxxxxxxxxxxxxxxxxxxxxxxxxxxxxxxxxxxxxxxxxxxxxxxxxxxxxxxxxxxxxxxxxxxxxxxxxxxxxxxxxxxxxxxxxxxx after, with a word longer than a line standing alone.
0x08 NON_ASCII — Températures en °C: la précision est de ±0,5 — 温度センサー.
0x0C EMPTY_TEXT

## Licence text in the file
Copyright (c) 2026 Example Corp. Licensed under the Apache License, Version 2.0 (the "License"); you may not use this file except in compliance with the License. Tabs and & entities stay.
