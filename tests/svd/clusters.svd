# CLUSTERS register map
Registers are 32-bit, read-write, no defined reset value unless marked. A register's access mark holds for its fields unless they carry their own. Offsets are from the block's base; lines under a group give offsets from that group; [hi:lo] are bit positions; {n}, {i} and the like mark numbered series; 'fields as' and 'values as' point back to an identical list; <NAME> marks a mode.

## Memory map
0x0C000000 CL — A peripheral of clusters.

## CL — A peripheral of clusters.
Base 0x0C000000
0x00 SINGLE group — One cluster.
  0x00 CTRL
  0x04 STATUS ro
{0x100+0x40*i} CTX[{i}] (i=0..1) group — A cluster array: its step is always written.
  0x00 THRESHOLD
  0x04 CLAIM read-modifies
0x200 LANE{x} (x=A,B; step 0x20) group — A list of clusters, one entry each and one type for both.
  0x00 CTRL — Named as the register of SINGLE, in a module of its own.
{0x400+0x100*i} GROUP[{i}] (i=0..1) group — A register array inside a cluster array.
  {0x0+4j} ITEM[{j}] (j=0..2)
0x600 VIEW_A group
  0x00 X
0x600 VIEW_B group (alternate view of VIEW_A) — Shares VIEW_A's bytes: in a group of its own.
  0x00 Y
0x700 COPY group — Derived from SINGLE: a cluster of its own.
  0x00 CTRL
  0x04 STATUS ro
0x800 OUTER group
  0x00 SHALLOW
  0x10 INNER group
    0x00 DEEP
0x900 BASE_REG
0x904 DERIVED_REG ro — Derived from BASE_REG, at its own offset.
