# OVERLAP register map
Registers are 32-bit, read-write, no defined reset value unless marked. A register's access mark holds for its fields unless they carry their own. Offsets are from the block's base; lines under a group give offsets from that group; [hi:lo] are bit positions; {n}, {i} and the like mark numbered series; 'fields as' and 'values as' point back to an identical list; <NAME> marks a mode.

## Memory map
0x40000000 A
0x40000000 C
0x40000008 B

## A
Base 0x40000000
Same registers: B 0x40000008
0x00 R0

## C
Base 0x40000000
0x00 R0
0x08 R2
